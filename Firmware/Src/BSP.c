#include "BSP.h"

int16_t I2S_ADCBuf[2048];
int16_t I2S_DACBuf[2048];
float fifo[4][1024];

float freq = 1000.0; 	//freq
uint32_t Wave_tick1 = 0;
uint32_t Wave_sum1 = 0;	//phase

extern I2C_HandleTypeDef hi2c1;
extern I2S_HandleTypeDef hi2s3;
extern void DSP_I2S_Callback(float* pt1, float* pt2, float* pt3, float* pt4, uint16_t offset);

const int16_t twiddleCoefQ15[] = {
0,147,295,442,589,736,883,1031,1178,1325,1472,1619,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-147
};
const float twiddleCoeff32[] = {
0.000000e+00,1.482388e-27,2.964720e-27,4.446941e-27,5.928994e-27,7.410824e-27,8.892375e-27,1.037359e-26,1.185442e-26,1.333480e-26,1.481467e-26,1.629399e-26,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-1.482388e-27
};

void BSP_Setfreq(float f)
{
	if(f>40000.0f)
		f = 40000.0f;
	if(f<0.0f)
		f = 0.0f;
	freq = f;
	Wave_tick1 = 42949.673f * f;
}

void HAL_I2S_TxHalfCpltCallback(I2S_HandleTypeDef *hi2s)
{
	uint16_t i,tmp;
//	HAL_GPIO_WritePin(GPIOB,GPIO_PIN_12,GPIO_PIN_SET);
	for(i=1;i<=1024;i+=2)
	{
		tmp = Wave_sum1>>22;	//10bit
		Wave_sum1 += Wave_tick1;
		
		I2S_DACBuf[i] = twiddleCoefQ15[tmp];
		fifo[0][i>>1] = I2S_ADCBuf[i-1];
		fifo[1][i>>1] = I2S_ADCBuf[i];
		fifo[2][i>>1] = twiddleCoeff32[tmp];
		fifo[3][i>>1] = twiddleCoeff32[(tmp+768)&0x3ff];		//2^10=1024
	}
	
	DSP_I2S_Callback(fifo[0], fifo[1], fifo[2], fifo[3], 0);
//	HAL_GPIO_WritePin(GPIOB,GPIO_PIN_12,GPIO_PIN_RESET);
}

void HAL_I2S_TxCpltCallback(I2S_HandleTypeDef *hi2s)
{
	uint16_t i,tmp;
//	HAL_GPIO_WritePin(GPIOB,GPIO_PIN_12,GPIO_PIN_SET);
	for(i=1024+1;i<=2048;i+=2)
	{
		tmp = Wave_sum1>>22;
		Wave_sum1 += Wave_tick1;
		
		I2S_DACBuf[i] = twiddleCoefQ15[tmp];
		fifo[0][i>>1] = I2S_ADCBuf[i-1];
		fifo[1][i>>1] = I2S_ADCBuf[i];
		fifo[2][i>>1] = twiddleCoeff32[tmp];
		fifo[3][i>>1] = twiddleCoeff32[(tmp+768)&0x3ff];		//2^10=1024
	}
	
	DSP_I2S_Callback(fifo[0], fifo[1], fifo[2], fifo[3], 512);
//	HAL_GPIO_WritePin(GPIOB,GPIO_PIN_12,GPIO_PIN_RESET);
}

const uint8_t CodecInit[][2] = 
{
	/* DAC Step */
	{0x00,0x00},	//Select Page 0
	{0x0b,0x81},	//NDAC = 1,Power up
	{0x0c,0x82},	//MDAC = 2,Power up
	{0x0d,0x00},	//DOSR = 128
	{0x0e,0x80},	//DOSR LSB
	{0x3c,0x01},	//PRB_P1
	
	/* ADC Step */
	{0x12,0x81},	//NADC = 1,Power up
	{0x13,0x82},	//MADC = 2,Power up
	{0x14,0x80},	//AOSR = 128
	{0x3d,0x01},	//PRB_R1
	
	/* Audio Interface */
	{0x1b,0x00},	//16bit,PTM_P4
	
	/* Power Step */
	{0x00,0x01},	//Select Page 1
	{0x01,0x08},	//Disabled weak connection of AVDD with DVDD
	{0x02,0x01},	//Analog Block Power up,AVDD LDO Power up
	//{0x0a,0x3b},	//Input Vcom = 0.9v,Output Vcom = 1.65v
	{0x0a,0x03},
	
	{0x03,0x00},	//DAC PTM mode		to PTM_P3/4
	{0x04,0x00},
	{0x3d,0x00},	//ADC PTM mode		to PTM_R4
	
//	{0x7b,0x01},	//REF settime			to 40ms
//	{0x14,0x25},	//HP settime			to	
	
	/* Input Step */
	{0x34,0x10},	//Route IN2L to LEFT_P with 10k
	{0x36,0x10},	//Route IN2R to LEFT_M with 10k
	{0x37,0x40},	//Route IN1R to RIGHT_P with 10k
	{0x39,0x10},	//Route IN1L to RIGHT_M with 10k
	
	{0x3b,0x00},	//Left  MicPGA not mute,gain to 0dB
	{0x3c,0x00},	//Right MicPGA not mute,gain to 0dB
	{0x53,0x00},	//Left  ADC Digital gain
	{0x54,0x00},	//Right ADC Digital gain
	
	/* Output Step */
	{0x0c,0x08},	//Route Left  DAC to HPL
	{0x0d,0x08},	//Route Right DAC to HPR
	{0x0e,0x08},	//Route Left  DAC to LOL
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	{0x09,0x3c},	//LOL,LOR,HPL,HPR,Power up
	
	/* Initial ok */
	{0x00,0x00},	//Select Page 0
	{0x3f,0xd6},	//L&R DAC Power up
	{0x40,0x00},	//L&R DAC not mute
	{0x51,0xc0},	//L&R ADC Power up
	{0x52,0x00},	//L&R ADC not mute
};

void BSP_CODEC_Init(void)
{
	uint16_t size = sizeof(CodecInit)/sizeof(CodecInit[0][0])/2;
	uint16_t i;

	//hi2s3.Instance->I2SPR = 0x0205;
	BSP_Setfreq(freq);
	
	/* TLV320AIC3204 reset */	
	Single_WriteI2C(0x00, 0x00);
	Single_WriteI2C(0x01, 0x01);
	
	HAL_Delay(5);
	
	for(i=0;i<size;i++)
			Single_WriteI2C(CodecInit[i][0],CodecInit[i][1]);
}

void BSP_CODEC_Start(void)
{
	HAL_I2SEx_TransmitReceive_DMA(&hi2s3,(uint16_t *)&I2S_DACBuf,(uint16_t *)&I2S_ADCBuf,2048);
}

void Single_WriteI2C(uint8_t REG_Address,uint8_t REG_data)
{
    uint8_t txData[2] = {REG_Address,REG_data};
    while(HAL_I2C_Master_Transmit(&hi2c1,I2C_ADDRESS,txData,2,100) != HAL_OK)
    {
        if(HAL_I2C_GetError(&hi2c1) != HAL_I2C_ERROR_AF)
        {}
    }
}
uint8_t Single_ReadI2C(uint8_t REG_Address)
{
    uint8_t REG_data;
    while(HAL_I2C_Master_Transmit(&hi2c1,I2C_ADDRESS,&REG_Address,1,100) != HAL_OK)
    {
        if(HAL_I2C_GetError(&hi2c1) != HAL_I2C_ERROR_AF)
        {}
    }
    
    if(HAL_I2C_Master_Receive(&hi2c1,I2C_ADDRESS+1,&REG_data,1,100) != HAL_OK)
    {
        if(HAL_I2C_GetError(&hi2c1) != HAL_I2C_ERROR_AF)
        {}
    }
    return REG_data;
}
